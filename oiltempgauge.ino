#include "KWP.h"
#include "U8glib.h"

#define pi 3.14159265359
#define pi2 2 * pi

#define MAX_CONNECT_RETRIES 5
#define NDASHBOARDGROUPS 1

#define pinKLineRX 2
#define pinKLineTX 3

KWP kwp(pinKLineRX, pinKLineTX);
int dashboardGroups[NDASHBOARDGROUPS] = { 3 };

KWP_MODULE dashboard = { "CLUSTER", ADR_Dashboard, 10400, dashboardGroups, NDASHBOARDGROUPS};
KWP_MODULE *modules[1]={ &dashboard};
KWP_MODULE *currentModule=modules[0];

int currentGroup=0;
int currentSensor=0;
int nSensors=0;
int maxSensors=4;
int connRetries=0;

int count=0;

char buffer[20];       // helper buffer for converting values into C-style string (array of chars)
int string_width;      // helper value for string widths

float pixel_x = 0;     // x pos for pixel
float pixel_y = 0;     // y pos for pixel
float line_x = 0;      // x pos for line end
float line_y = 0;      // y pos for line end
float text_x = 0;      // x pos for text
float text_y = 0;      // y pos for text

int center_x = 40;     // x center of the knob 
int center_y = 43;    // y center of the knob (outside of the screen)
int radius_pixel = 42; // radius for pixel tickmarks
int radius_line = 32;  // radius for line end
int radius_text = 22;  // radius for text

int angle;             // angle for the individual tickmarks
int tick_value;        // numeric value for the individual tickmarks

byte precalculated_x_radius_pixel[180]; // lookup table to prevent expensive sin/cos calculations
byte precalculated_y_radius_pixel[180]; // lookup table to prevent expensive sin/cos calculations

U8GLIB_SSD1306_128X64 u8g(U8G_I2C_OPT_NONE|U8G_I2C_OPT_DEV_0);

const unsigned char seat [] PROGMEM = {
  0x00, 0x00, 0x00, 0x00, 0x00, 0x00, 0x00, 0x00, 0x00, 0x00, 0x00, 0x00, 0x00, 0x00, 0x00, 0x00, 
  0x00, 0x00, 0x00, 0x00, 0x00, 0x00, 0x00, 0x00, 0x00, 0x00, 0x00, 0x00, 0x00, 0x00, 0x00, 0x00, 
  0x00, 0x00, 0x00, 0x00, 0x00, 0x00, 0x00, 0x00, 0x00, 0x00, 0x00, 0x00, 0x00, 0x00, 0x00, 0x00, 
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  0x00, 0x00, 0x00, 0x00, 0x00, 0x00, 0x00, 0x00, 0x00, 0x00, 0x00, 0x00, 0x00, 0x00, 0x00, 0x00
};

const uint8_t upir_logo[] U8G_PROGMEM ={
 0x00, 0x00, 0x00, 0x03, 0xff, 0xff, 0xe0, 0x00, 0x00, 0x00, 0x00, 0x00, 0x00, 0x00, 0x00, 0x00, 
  0x00, 0x00, 0x00, 0x1f, 0xff, 0xff, 0xfc, 0x00, 0x00, 0x00, 0x00, 0x00, 0x00, 0x00, 0x00, 0x00, 
  0x00, 0x00, 0x00, 0xff, 0xff, 0xff, 0xff, 0x80, 0x00, 0x00, 0x00, 0x00, 0x00, 0x00, 0x00, 0x00, 
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  0x01, 0xfe, 0x00, 0x00, 0x00, 0x00, 0x00, 0x00, 0x00, 0x00, 0x00, 0x00, 0x00, 0x00, 0x00, 0x00
};

const unsigned char Snowflake [] PROGMEM = {
  0x00, 0x00, 0x00, 0x00, 0x18, 0x00, 0x00, 0x7e, 0x00, 0x09, 0x3c, 0x90, 0x07, 0x18, 0xe0, 0x1e, 
  0x18, 0x78, 0x1f, 0x18, 0xf8, 0x13, 0x99, 0xc8, 0x01, 0xdb, 0x80, 0x20, 0xff, 0x04, 0x30, 0x7e, 
  0x0c, 0x7f, 0xff, 0xfe, 0x7f, 0xff, 0xfe, 0x30, 0x7e, 0x0c, 0x20, 0xff, 0x04, 0x01, 0xdb, 0x80, 
  0x13, 0x99, 0xc8, 0x1f, 0x18, 0xf8, 0x1e, 0x18, 0x78, 0x07, 0x18, 0xe0, 0x09, 0x3c, 0x90, 0x00, 
  0x7e, 0x00, 0x00, 0x18, 0x00, 0x00, 0x00, 0x00
};

const unsigned char temp [] PROGMEM = {
  0x00, 0x00, 0x00, 0x00, 0x18, 0x00, 0x00, 0x18, 0x00, 0x00, 0x18, 0x00, 0x00, 0x1f, 0x00, 0x00, 
  0x18, 0x00, 0x00, 0x18, 0x00, 0x00, 0x1f, 0x00, 0x00, 0x18, 0x00, 0x00, 0x18, 0x00, 0x00, 0x1f, 
  0x00, 0x00, 0x18, 0x00, 0x00, 0x18, 0x00, 0x00, 0x18, 0x00, 0x00, 0x18, 0x00, 0xe3, 0xbd, 0xc7, 
  0x3e, 0x3c, 0x7c, 0x00, 0x18, 0x00, 0xe3, 0xc3, 0x83, 0x36, 0x66, 0xee, 0x1c, 0x3c, 0x38, 0x00, 
  0x00, 0x00, 0x00, 0x00, 0x00, 0x00, 0x00, 0x00
};

float angleToXD(float centerX, float radius, float angleD) {
    float angle = (angleD / 360) * (pi2);
    return centerX+radius*cos(angle); // Calculate arc point (X)
}
float angleToYD(float centerY, float radius, float angleD) {
    float angle = (angleD / 360) * (pi2);
    return centerY+radius*sin(angle); // Calculate arc point (Y)
}
void drawNeedle(float angle, float centerX, float centerY, int radius){
    int r = 45;
    float leftX = angleToXD(centerX, radius+1, angle - r);
    float leftY = angleToYD(centerY, radius+1, angle - r);
  
    float rightX = angleToXD(centerX, radius+1, angle + r);
    float rightY = angleToYD(centerY, radius+1, angle + r);
  
    float topX = angleToXD(centerX, radius+30, angle);
    float topY = angleToYD(centerY, radius+30, angle);
  
    u8g.drawTriangle(leftX,leftY,topX,topY,rightX,rightY);
}

int oil_val = 0;

void setup() {  
  delay(200);
  u8g.setColorIndex(1);          // set color to white
  u8g.firstPage();                
  do {          
  u8g.drawBitmapP(0, 0, 128/8, 64, seat); 
  } while ( u8g.nextPage() );
}

void loop() {  
  if(!kwp.isConnected()){
    if(kwp.connect(0x17, 10400)){
      delay(300);
      connRetries=0;
    }
  }else{
    SENSOR resultBlock[maxSensors];
    nSensors=kwp.readBlock(currentModule->addr, currentModule->groups[currentGroup], maxSensors, resultBlock);
    if(resultBlock[currentSensor].value != ""){
      String oil=resultBlock[2].value;
      String water=resultBlock[0].value; 
      oil_val = oil.toInt();    
    }
  }  
  u8g.firstPage();                 
  do {
    u8g.setColorIndex(1);          
    u8g.setFont(u8g_font_fub30n);  
    u8g.setColorIndex(1);
    u8g.drawBitmapP(0, 0, 128/8, 64, upir_logo);  
    drawNeedle(map(oil_val, -15, 120, -210, -40), 45, 45, 3); 
    u8g.setPrintPos(60, 64); u8g.print(oil_val);   
    if (oil_val < 55){
      u8g.drawBitmapP(40, 17, 24/8, 24, Snowflake);
    }
    if (oil_val >= 105){
      u8g.drawBitmapP(15, 15, 24/8, 24, temp);
    }
  } while ( u8g.nextPage() ); 
}
